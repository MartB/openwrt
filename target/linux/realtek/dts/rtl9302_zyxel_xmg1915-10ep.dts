// SPDX-License-Identifier: GPL-2.0-or-later
/dts-v1/;

#include "rtl9302_zyxel_xmg1915.dtsi"
#include "rtl9302_zyxel_xmg1915-poe.dtsi"

#include <dt-bindings/input/input.h>
#include <dt-bindings/gpio/gpio.h>
#include <dt-bindings/leds/common.h>

/* Blue, green and red of a copper port, left to the scan engine by default */
#define PORT_LEDS(n, slot, unit)				\
	led@unit,0 {						\
		reg = <slot 0>;					\
		color = <LED_COLOR_ID_BLUE>;			\
		function = LED_FUNCTION_LAN;			\
		function-enumerator = <n>;			\
		linux,default-trigger = "rtl930x-hw";		\
	};							\
	led@unit,1 {						\
		reg = <slot 1>;					\
		color = <LED_COLOR_ID_GREEN>;			\
		function = LED_FUNCTION_LAN;			\
		function-enumerator = <n>;			\
		linux,default-trigger = "rtl930x-hw";		\
	};							\
	led@unit,2 {						\
		reg = <slot 2>;					\
		color = <LED_COLOR_ID_RED>;			\
		function = LED_FUNCTION_LAN;			\
		function-enumerator = <n>;			\
		linux,default-trigger = "rtl930x-hw";		\
	};

/* Blue for 10G and green for 1G of an SFP+ cage, both lit for 2.5G */
#define SFP_LEDS(n, slot, unit)					\
	led@unit,0 {						\
		reg = <slot 0>;					\
		color = <LED_COLOR_ID_BLUE>;			\
		function = LED_FUNCTION_LAN;			\
		function-enumerator = <n>;			\
		linux,default-trigger = "rtl930x-hw";		\
	};							\
	led@unit,1 {						\
		reg = <slot 1>;					\
		color = <LED_COLOR_ID_GREEN>;			\
		function = LED_FUNCTION_LAN;			\
		function-enumerator = <n>;			\
		linux,default-trigger = "rtl930x-hw";		\
	};

/ {
	compatible = "zyxel,xmg1915-10ep", "realtek,rtl9302c-soc";
	model = "Zyxel XMG1915-10EP Switch";

	keys {
		compatible = "gpio-keys";

		led-mode {
			label = "led-mode";
			gpios = <&gpio0 11 GPIO_ACTIVE_LOW>;
			linux,code = <BTN_1>;
		};
	};
};

&led_set {
	/*
	 * The PoE indicator, next to CLOUD:
	 *   slot 23 LED 1: PoE blue, never used by the stock firmware
	 *   slot 24 LED 0: PoE green
	 *   slot 24 LED 1: PoE red, lit together with green for amber
	 *
	 * The copper port LEDs (slots 0-3 and 8-11) have their blue, green and
	 * red elements at LED 0, 1 and 2. In its PoE display mode the stock
	 * firmware takes those over as well and shows the PD class: yellow for
	 * 802.3af, green for 802.3at, blue for 802.3bt.
	 */
	software-leds {
		led@17,1 {
			reg = <23 1>;
			color = <LED_COLOR_ID_BLUE>;
			function = "poe";
		};

		led@18,0 {
			reg = <24 0>;
			color = <LED_COLOR_ID_GREEN>;
			function = "poe";
		};

		led@18,1 {
			reg = <24 1>;
			color = <LED_COLOR_ID_RED>;
			function = "poe";
		};

		PORT_LEDS(1, 0, 0)
		PORT_LEDS(2, 1, 1)
		PORT_LEDS(3, 2, 2)
		PORT_LEDS(4, 3, 3)
		PORT_LEDS(5, 8, 8)
		PORT_LEDS(6, 9, 9)
		PORT_LEDS(7, 10, a)
		PORT_LEDS(8, 11, b)
		SFP_LEDS(9, 25, 19)
		SFP_LEDS(10, 27, 1b)
	};
};

&pse {
	compatible = "zyxel,xmg1915-10ep-pse", "realtek,pse-mcu-gen2";
};
