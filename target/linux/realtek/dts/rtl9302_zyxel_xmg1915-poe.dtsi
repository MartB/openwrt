// SPDX-License-Identifier: GPL-2.0-or-later

/*
 * PoE on the XMG1915-10EP and -18EP: the same MCU on the same UART, feeding
 * the first eight copper ports. Boards set their own compatible on &pse.
 */

&uart1 {
	status = "okay";

	pse: ethernet-pse {
		compatible = "realtek,pse-mcu-gen2";
		current-speed = <115200>;

		reset-gpios = <&gpio0 4 GPIO_ACTIVE_LOW>;

		pse-pis {
			#address-cells = <1>;
			#size-cells = <0>;

			PSE_PI(0)
			PSE_PI(1)
			PSE_PI(2)
			PSE_PI(3)
			PSE_PI(4)
			PSE_PI(5)
			PSE_PI(6)
			PSE_PI(7)
		};
	};
};

&phy0 { pses = <&pse_pi0>; };
&phy1 { pses = <&pse_pi1>; };
&phy2 { pses = <&pse_pi2>; };
&phy3 { pses = <&pse_pi3>; };
&phy8 { pses = <&pse_pi4>; };
&phy9 { pses = <&pse_pi5>; };
&phy10 { pses = <&pse_pi6>; };
&phy11 { pses = <&pse_pi7>; };
