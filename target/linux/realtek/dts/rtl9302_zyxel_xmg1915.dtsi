// SPDX-License-Identifier: GPL-2.0-or-later

/* The 10-port boards: XMG1915-10E and -10EP. */

#include "rtl9302_zyxel_xmg1915-common.dtsi"

/* Blue, green and red of a copper port, left to the scan engine by default */
#define PORT_LEDS(n, slot, unit)				\
	led@unit,0 {						\
		reg = <slot 0>;					\
		color = <LED_COLOR_ID_BLUE>;			\
		function = LED_FUNCTION_LAN;			\
		function-enumerator = <n>;			\
		linux,default-trigger = "rtl930x-hw";		\
	};							\
	led@unit,1 {						\
		reg = <slot 1>;					\
		color = <LED_COLOR_ID_GREEN>;			\
		function = LED_FUNCTION_LAN;			\
		function-enumerator = <n>;			\
		linux,default-trigger = "rtl930x-hw";		\
	};							\
	led@unit,2 {						\
		reg = <slot 2>;					\
		color = <LED_COLOR_ID_RED>;			\
		function = LED_FUNCTION_LAN;			\
		function-enumerator = <n>;			\
		linux,default-trigger = "rtl930x-hw";		\
	};

/* Blue for 10G and green for 1G of an SFP+ cage, both lit for 2.5G */
#define SFP_LEDS(n, slot, unit)					\
	led@unit,0 {						\
		reg = <slot 0>;					\
		color = <LED_COLOR_ID_BLUE>;			\
		function = LED_FUNCTION_LAN;			\
		function-enumerator = <n>;			\
		linux,default-trigger = "rtl930x-hw";		\
	};							\
	led@unit,1 {						\
		reg = <slot 1>;					\
		color = <LED_COLOR_ID_GREEN>;			\
		function = LED_FUNCTION_LAN;			\
		function-enumerator = <n>;			\
		linux,default-trigger = "rtl930x-hw";		\
	};

/ {
	led_set: led_set {
		compatible = "realtek,rtl9300-leds";
		active-low;

		/* Copper */
		led_set0 = <(RTL93XX_LED_SET_100M | RTL93XX_LED_SET_LINK |
			     RTL93XX_LED_SET_ACT)
			    (RTL93XX_LED_SET_100M |RTL93XX_LED_SET_1G |
			     RTL93XX_LED_SET_2P5G | RTL93XX_LED_SET_LINK |
			     RTL93XX_LED_SET_ACT)
			    (RTL93XX_LED_SET_2P5G | RTL93XX_LED_SET_LINK |
			     RTL93XX_LED_SET_ACT)>;
		/* SFP+ */
		led_set1 = <(RTL93XX_LED_SET_1G | RTL93XX_LED_SET_2P5G |
			     RTL93XX_LED_SET_LINK | RTL93XX_LED_SET_ACT)
			     (RTL93XX_LED_SET_10G | RTL93XX_LED_SET_2P5G |
			     RTL93XX_LED_SET_LINK | RTL93XX_LED_SET_ACT)>;

		/* PoE and Cloud are 4 leds in total but software managed.
		   Assign them to led_set 1 to avoid shifting the others
		   incorrectly. */
		realtek,led-set1-force-port-mask = <0x01800000>;

		/*
		 * CLOUD and, on the PoE models, the PoE indicator, in the scan
		 * slots after the copper ports. CLOUD is slot 23 LED 0.
		 *
		 * The copper port LEDs (slots 0-3 and 8-11) have their blue,
		 * green and red elements at LED 0, 1 and 2; the SFP+ cages
		 * (slots 25 and 27) blue and green. Left to the scan engine,
		 * they show link speed; as LEDs here they can be turned off.
		 */
		software-leds {
			#address-cells = <2>;
			#size-cells = <0>;

			led@17,0 {
				reg = <23 0>;
				color = <LED_COLOR_ID_GREEN>;
				function = "cloud";
			};

			PORT_LEDS(1, 0, 0)
			PORT_LEDS(2, 1, 1)
			PORT_LEDS(3, 2, 2)
			PORT_LEDS(4, 3, 3)
			PORT_LEDS(5, 8, 8)
			PORT_LEDS(6, 9, 9)
			PORT_LEDS(7, 10, a)
			PORT_LEDS(8, 11, b)
			SFP_LEDS(9, 25, 19)
			SFP_LEDS(10, 27, 1b)
		};
	};
};

&switch0 {
	ethernet-ports {
		#address-cells = <1>;
		#size-cells = <0>;

		/* Copper ports */
		SWITCH_PORT_LED(0, 1, 2, 0, 0, 10g-qxgmii)
		SWITCH_PORT_LED(1, 2, 2, 1, 0, 10g-qxgmii)
		SWITCH_PORT_LED(2, 3, 2, 2, 0, 10g-qxgmii)
		SWITCH_PORT_LED(3, 4, 2, 3, 0, 10g-qxgmii)
		SWITCH_PORT_LED(8, 5, 3, 0, 0, 10g-qxgmii)
		SWITCH_PORT_LED(9, 6, 3, 1, 0, 10g-qxgmii)
		SWITCH_PORT_LED(10, 7, 3, 2, 0, 10g-qxgmii)
		SWITCH_PORT_LED(11, 8, 3, 3, 0, 10g-qxgmii)

		/* SFP cages */
		SWITCH_PORT_SFP(25, 9, 7, 1, 0)
		SWITCH_PORT_SFP(27, 10, 9, 1, 1)

		port@28 {
			ethernet = <&ethernet0>;
			reg = <28>;
			phy-mode = "internal";
			fixed-link {
				speed = <1000>;
				full-duplex;
			};
		};
	};
};
